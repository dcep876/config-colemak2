## config/west.yml
```yaml
manifest:
  remotes:
    - name: zmkfirmware
      url-base: https://github.com/zmkfirmware
  projects:
    - name: zmk
      remote: zmkfirmware
      revision: main # or a specific version tag like 'v0.3.0'
      import: app/west.yml
  self:
    path: config
```
